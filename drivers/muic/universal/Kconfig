## drivers/muic/universal/Kconfig
```kconfig
# MUIC_UNIVERSAL

config MUIC_UNIVERSAL
	bool "UNIVERSAL MUIC"
	depends on USE_MUIC
	default n
	help
	  If you say yes here you will get support for various MUIC chips.

config MUIC_UNIVERSAL_SM5703
	bool "SM5703 MUIC"
	depends on USE_MUIC
	default n
	help
	  If you say yes here you will get support for the SM5703 MUIC chip.

config MUIC_UNIVERSAL_MAX77849
	bool "MAX77849 MUIC"
	depends on USE_MUIC
	default n
	help
	  If you say yes here you will get support for the MAX77849 MUIC chip.
```
